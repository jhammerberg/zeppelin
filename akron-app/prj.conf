## CMakeLists.txt
```
cmake_minimum_required(VERSION 3.20.0)
set(CMAKE_EXPORT_COMPILE_COMMANDS ON)
set(BOARD esp32_devkitc/esp32/procpu) # default board

# Pull in the sibling helium-lib as an out-of-tree Zephyr module
list(APPEND ZEPHYR_EXTRA_MODULES ${CMAKE_CURRENT_SOURCE_DIR}/../helium-lib)

find_package(Zephyr REQUIRED HINTS $ENV{ZEPHYR_BASE})
project(akron-app)

target_sources(app PRIVATE src/main.c src/wifi.c)
```

## prj.conf
```kconfig
# Common project settings for all platforms.
#
# Keep this file minimal: only options that BOTH the hardware target and the
# native_sim build genuinely use belong here. Anything specific to a transport
# (e.g. Wi-Fi, its credential storage, or a particular flash backend) lives in
# the per-board files under boards/ so the sim never pulls in target-only code.

# Settings
CONFIG_SETTINGS=y

# GPIO
CONFIG_GPIO=y

# Logging
CONFIG_LOG=y

# Console
CONFIG_SHELL=y

# Memory
#
# Stack sizes are sized for Xtensa (ESP32), whose windowed-register ABI uses
# considerably more stack than ARM/x86; measured high-water marks on hardware
# (kernel thread stacks) showed the previous/default values overflowing, which
# corrupts adjacent kernel memory and hangs the system.
CONFIG_HEAP_MEM_POOL_SIZE=65536
CONFIG_MAIN_STACK_SIZE=3072
CONFIG_SHELL_STACK_SIZE=4096
CONFIG_SYSTEM_WORKQUEUE_STACK_SIZE=3072
# Network RX thread: parses DHCP options, reconfigures DNS, dispatches DNS
# responses. Overflowed at its previous size of 2048.
CONFIG_NET_RX_STACK_SIZE=4096
CONFIG_NET_MGMT_EVENT_STACK_SIZE=3072

# Networking
CONFIG_NETWORKING=y
CONFIG_NET_IPV4=y
CONFIG_NET_TCP=y
CONFIG_NET_UDP=y
CONFIG_NET_DHCPV4=y
CONFIG_NET_SOCKETS=y
CONFIG_NET_SHELL=y
CONFIG_NET_L2_ETHERNET=y

## Hostname
CONFIG_NET_HOSTNAME_ENABLE=y
CONFIG_NET_HOSTNAME="zeppelin"

## Connection Manager configuration
CONFIG_NET_CONNECTION_MANAGER=y
# The upstream default monitor stack is 512 B, which overflows on Xtensa and
# silently corrupts adjacent kernel memory (hangs/crashes within ~30 s of
# network activity). Measured high-water mark on ESP32 was ~1.9 kB.
CONFIG_NET_CONNECTION_MANAGER_MONITOR_STACK_SIZE=2560
CONFIG_NET_MGMT_EVENT_QUEUE_SIZE=16
CONFIG_NET_MGMT_EVENT_QUEUE_TIMEOUT=5000

## SNTP time sync
CONFIG_SNTP=y
```

## boards/esp32_devkitc_procpu.conf
```kconfig
# ESP32 specific settings

# Networking

## WiFi
CONFIG_WIFI=y
CONFIG_WIFI_ESP32=y
CONFIG_NET_L2_WIFI_MGMT=y
CONFIG_NET_L2_WIFI_SHELL=y
CONFIG_NET_CONNECTION_MANAGER_CONNECTIVITY_WIFI_MGMT=y

## mDNS responder: answers "<hostname>.local" queries (e.g. "zeppelin.local")
## so the device is reachable by name without relying on the router's DNS.
CONFIG_MDNS_RESPONDER=y
# The mDNS listener sockets share the DNS dispatcher's poll set with the DNS
# resolver; the default of 3 poll descriptors is too small once both are on.
CONFIG_ZVFS_POLL_MAX=8

## Resolve hostnames using DNS servers supplied by DHCP
CONFIG_DNS_RESOLVER=y
# Two slots so the DHCP (IPv4) and router-advertisement (IPv6) DNS servers do
# not evict each other from a single-entry list (the default is 1, which made
# name resolution depend on which source configured itself last).
CONFIG_DNS_RESOLVER_MAX_SERVERS=2

## Wi-Fi credentials library (used to pre-configure/store credentials)
CONFIG_WIFI_CREDENTIALS=y
CONFIG_WIFI_CREDENTIALS_CONNECT_STORED=y

## Persistent storage backing the credentials library
CONFIG_SETTINGS_NVS=y
CONFIG_NVS=y
CONFIG_FLASH=y
CONFIG_FLASH_MAP=y

# Memory

## Mbed TLS
# CONFIG_MBEDTLS_ENABLE_HEAP=y
# CONFIG_MBEDTLS_HEAP_SIZE=60000
```

## boards/native_sim.conf
```kconfig
# POSIX simulation (native_sim) specific settings.
#
# Wi-Fi and its credential storage are intentionally NOT enabled here: they
# live only in the hardware board configs, so the sim never drags in
# target-only code (e.g. SHELL_GETOPT vs. host-libc getopt.h conflicts).

# Networking: use Native Simulator Offloaded Sockets (NSOS) instead of the
# TAP/zeth ethernet driver. NSOS forwards the app's BSD socket calls straight
# to the host kernel, so the sim gets the host's real internet access with no
# root, TAP interface, dnsmasq, or NET_ADMIN setup required. DNS (getaddrinfo)
# is served by the host resolver, so SNTP against pool.ntp.org works directly.
CONFIG_ETH_NATIVE_TAP=n
CONFIG_NET_DRIVERS=y
CONFIG_NET_SOCKETS_OFFLOAD=y
CONFIG_NET_NATIVE_OFFLOADED_SOCKETS=y

# Simulate the connectivity API so conn_mgr_if_connect() and the
# NET_EVENT_L4_CONNECTED/DISCONNECTED events behave just like on real hardware.
# This keeps the sim and ESP32 application code paths identical (the iface is
# bound to a connectivity backend on both), rather than needing sim-only code.
CONFIG_NET_NATIVE_OFFLOADED_SOCKETS_CONNECTIVITY_SIM=y

# IPv6 Duplicate Address Detection needs lower-level interface access than the
# socket-level NSOS driver exposes, so it must be disabled.
CONFIG_NET_IPV6_DAD=n

# NSOS's connectivity sim brings the interface oper-up but assigns no IP. The
# conn_mgr monitor only raises NET_EVENT_L4_CONNECTED once the iface is both
# oper-up AND has an IP, so assign a static (cosmetic) address at startup.
# Actual traffic egresses via the host socket regardless of this address.
# INIT_TIMEOUT=0 makes net_config assign the address immediately without
# waiting for the iface to be up (it is only brought up later, once the app
# calls conn_mgr_if_connect()), avoiding a startup stall.
CONFIG_NET_CONFIG_SETTINGS=y
CONFIG_NET_CONFIG_MY_IPV4_ADDR="192.0.2.1"
CONFIG_NET_CONFIG_INIT_TIMEOUT=0

# DHCPv4 is meaningless under NSOS (there is no real L2 to send on) and only
# produces "l2 cannot send, discard pkt" warnings, so disable it for the sim.
# The static address above is all conn_mgr needs to report L4 connectivity.
CONFIG_NET_DHCPV4=n

# Run against real wall-clock time so network round-trips and SNTP timeouts
# behave sensibly against real internet servers.
CONFIG_NATIVE_SIM_SLOWDOWN_TO_REAL_TIME=y
```

## app.overlay
```dts
/ {
    aliases {
        led0 = &blink_led;
    };

    leds {
        compatible = "gpio-leds";
        blink_led: led_gpio {
            gpios = <&gpio0 2 GPIO_ACTIVE_HIGH>;
        };
    };
};
```

## src/main.c
```c
#include <zephyr/drivers/gpio.h>
#include <zephyr/kernel.h>
#include <zephyr/net/hostname.h>

#include "init.h"

#define SLEEP_TIME_MS 1000

int main(void) {
    int ret = init();
    if (ret != 0) {
        printk("Init failed :(");
        return ret;
    }

    const char *name = net_hostname_get();
    printk("Current device hostname: %s\n", name);

    while (1) {
        gpio_pin_toggle_dt(&led);  // led is an extern
        printk("LED Toggled\n");
        k_msleep(SLEEP_TIME_MS);
    }

    return 0;
}
```

## src/conn_mgr_wifi.c
```c
/*
 * Application-defined connectivity backend for the generic WIFI_MGMT
 * connection manager binding.
 *
 * As of Zephyr v4.3, CONFIG_NET_CONNECTION_MANAGER_CONNECTIVITY_WIFI_MGMT only
 * declares the CONNECTIVITY_WIFI_MGMT implementation (extern) and binds WiFi
 * ifaces to it (see drivers/wifi/.../CONNECTIVITY_WIFI_MGMT_BIND). The only
 * Kconfig choice, CONNECTIVITY_WIFI_MGMT_APPLICATION, requires the application
 * to *define* that implementation. This file provides that definition.
 */

#include <zephyr/logging/log.h>
#include <zephyr/net/conn_mgr/connectivity_wifi_mgmt.h>
#include <zephyr/net/conn_mgr_connectivity_impl.h>
#include <zephyr/net/net_if.h>
#include <zephyr/net/net_mgmt.h>
#include <zephyr/net/wifi_mgmt.h>

LOG_MODULE_REGISTER(conn_mgr_wifi, LOG_LEVEL_INF);

/* Start association. Must be non-blocking: net_mgmt requests to the WiFi L2
 * kick off the connection and the driver raises WiFi/L4 events on completion.
 */
static int wifi_mgmt_connect(struct conn_mgr_conn_binding* const binding) {
    struct net_if* iface = binding->iface;

#if defined(CONFIG_WIFI_CREDENTIALS_CONNECT_STORED)
    /* Connect using credentials stored via the wifi_credentials library. */
    int ret = net_mgmt(NET_REQUEST_WIFI_CONNECT_STORED, iface, NULL, 0);

    if (ret) {
        LOG_ERR("Failed to request connect with stored credentials: %d", ret);
    }
    return ret;
#else
    LOG_ERR(
        "No connect method available: enable CONFIG_WIFI_CREDENTIALS_CONNECT_STORED "
        "or provide explicit connect parameters");
    ARG_UNUSED(iface);
    return -ENOTSUP;
#endif
}

/* Tear down the association / cancel any in-progress connection attempt. */
static int wifi_mgmt_disconnect(struct conn_mgr_conn_binding* const binding) {
    struct net_if* iface = binding->iface;
    int ret = net_mgmt(NET_REQUEST_WIFI_DISCONNECT, iface, NULL, 0);

    if (ret) {
        LOG_ERR("Failed to request disconnect: %d", ret);
    }
    return ret;
}

/* Per-binding init hook. Nothing WiFi-specific to set up here. */
static void wifi_mgmt_init(struct conn_mgr_conn_binding* const binding) {
    ARG_UNUSED(binding);
}

static struct conn_mgr_conn_api conn_api = {
    .connect = wifi_mgmt_connect,
    .disconnect = wifi_mgmt_disconnect,
    .init = wifi_mgmt_init,
};

CONN_MGR_CONN_DEFINE(CONNECTIVITY_WIFI_MGMT, &conn_api);
```

## src/init.c
```c
/*
 * All initialization
 */

#include "init.h"

#include <helium/time.h>
#include <zephyr/drivers/gpio.h>
#include <zephyr/kernel.h>
#include <zephyr/logging/log.h>
#include <zephyr/net/conn_mgr_connectivity.h>
#include <zephyr/net/net_event.h>
#include <zephyr/net/net_if.h>

// Network timeout in milliseconds, for no timeout do K_FOREVER
#define NETWORK_TIMEOUT_VAL 30000

LOG_MODULE_REGISTER(init, LOG_LEVEL_INF);

// Semaphores and callback storage must outlive the registered network events.
K_SEM_DEFINE(network_connected, 0, 1);
K_SEM_DEFINE(network_disconnected, 0, 1);
static struct net_mgmt_event_callback l4_cb;

// Pull the led0 specification from the devicetree overlay
const struct gpio_dt_spec led = GPIO_DT_SPEC_GET(DT_ALIAS(led0), gpios);
const struct gpio_dt_spec button = GPIO_DT_SPEC_GET(DT_ALIAS(button0), gpios);

// Button callback data and handler
static struct gpio_callback button_cb_data;
void button_pressed_handler(const struct device* port, struct gpio_callback* cb,
                            gpio_port_pins_t pins) {
    printk("Button Pressed!\n");
}

// Event handler for Layer 4 (IP connectivity) events
static void l4_event_handler(struct net_mgmt_event_callback* cb, uint64_t event,
                             struct net_if* iface) {
    switch (event) {
        case NET_EVENT_L4_CONNECTED:
            LOG_INF("Network L4 Connected!");
            k_sem_give(&network_connected);
            break;
        case NET_EVENT_L4_DISCONNECTED:
            LOG_INF("Network L4 Disconnected!");
            k_sem_give(&network_disconnected);
            break;
        case NET_EVENT_IPV4_ADDR_ADD:
            LOG_INF("Got an IP");
            break;
        default:
            break;
    }
}

// Init GPIO
int gpio_init(void) {
    LOG_INF("Initializing GPIO");
    if (!gpio_is_ready_dt(&led) || !gpio_is_ready_dt(&button)) return -1;

    int err;
    err = gpio_pin_configure_dt(&led, GPIO_OUTPUT_ACTIVE);
    if (err != 0) return err;
    err = gpio_pin_configure_dt(&button, GPIO_INPUT);
    if (err != 0) return err;

    // Configure the button interrupt
    gpio_pin_interrupt_configure_dt(&button, GPIO_INT_EDGE_TO_ACTIVE);
    gpio_init_callback(&button_cb_data, button_pressed_handler, BIT(button.pin));
    gpio_add_callback_dt(&button, &button_cb_data);
    LOG_INF("Done initializng GPIO");
    return 0;
}

int net_init(void) {
    LOG_INF("Initialzing network");

    int err;
    struct net_if* iface = net_if_get_default();

    if (iface == NULL) {
        LOG_ERR("No default network interface found");
        return -ENODEV;
    }

    net_mgmt_init_event_callback(&l4_cb, l4_event_handler,
                                 NET_EVENT_L4_CONNECTED | NET_EVENT_L4_DISCONNECTED);
    net_mgmt_add_event_callback(&l4_cb);

    // Check if the network interface even needs to be bound for something like WiFi vs
    // Ethernet
    if (conn_mgr_if_is_bound(iface)) {
        // Attempt to connect (non-blocking)
        // This is generic but will go to a connection manager
        // implementation depending on the target's available interfaces
        err = conn_mgr_if_connect(iface);
        if (err != 0 && err != -EALREADY) return err;
    }

    // Wait until we actually connect
    err = k_sem_take(&network_connected, K_MSEC(NETWORK_TIMEOUT_VAL));
    if (err == 0) {
        LOG_INF("Done initializing network");
    } else if (err == -EBUSY) {
        LOG_ERR("Error initializing network connection");
        return err;
    } else if (err == -EAGAIN) {
        LOG_ERR("Timed out waiting for network connection");
        return err;
    } else {
        LOG_ERR("dafuq?");
        return err;
    }
    return 0;
}

// Initialize all GPIO, start networking, sync system time, etc
int init(void) {
    int err;

    // Init GPIO
    err = gpio_init();
    if (err != 0) return err;

    // Init network
    err = net_init();
    if (err != 0) return err;

    // Init time
    LOG_INF("Initializing system time");
    if (!time_sync_now()) {
        LOG_INF("Done initializing system time");
    } else {
        LOG_WRN("Continuing without synchronized system time");
    }

    // Done!
    LOG_INF("All initialization finished!");
    return 0;
}
```

## src/init.h
```c
/*
 * All initialization
 */

#pragma once

#include <helium/time.h>
#include <zephyr/drivers/gpio.h>
#include <zephyr/kernel.h>
#include <zephyr/net/conn_mgr_connectivity.h>
#include <zephyr/net/net_event.h>
#include <zephyr/net/net_if.h>

extern const struct gpio_dt_spec led;

// Initialize all GPIO, start networking, sync system time, etc
int init(void);
```

## src/wifi.c
```c
#include "wifi.h"

#include <zephyr/kernel.h>
#include <zephyr/logging/log.h>
#include <zephyr/net/net_event.h>
#include <zephyr/net/net_if.h>
#include <zephyr/net/wifi_mgmt.h>

LOG_MODULE_REGISTER(wifi, LOG_LEVEL_INF);

#if defined(CONFIG_WIFI)

/* Events we listen for to determine connection outcome */
#define WIFI_MGMT_EVENTS \
    (NET_EVENT_WIFI_CONNECT_RESULT | NET_EVENT_WIFI_DISCONNECT_RESULT)

/* Signalled by the event handler once a connect result is available */
static struct k_sem wifi_connected_sem;

/* Callback registration for Wi-Fi management events */
static struct net_mgmt_event_callback wifi_mgmt_cb;

/* Result of the most recent connection attempt (0 = success) */
static int wifi_connect_status = -1;

static void wifi_mgmt_event_handler(struct net_mgmt_event_callback* cb,
                                    uint32_t mgmt_event, struct net_if* iface) {
    ARG_UNUSED(iface);

    switch (mgmt_event) {
        case (uint32_t)NET_EVENT_WIFI_CONNECT_RESULT: {
            const struct wifi_status* status = (const struct wifi_status*)cb->info;

            if (status->status) {
                LOG_ERR("Connection request failed (status %d)", status->status);
                wifi_connect_status = -1;
            } else {
                LOG_INF("Connected to Wi-Fi");
                wifi_connect_status = 0;
            }

            k_sem_give(&wifi_connected_sem);
            break;
        }

        case (uint32_t)NET_EVENT_WIFI_DISCONNECT_RESULT: {
            LOG_INF("Disconnected from Wi-Fi");
            wifi_connect_status = -1;
            k_sem_give(&wifi_connected_sem);
            break;
        }

        default:
            break;
    }
}

static int wifi_do_connect(struct net_if* iface, const char* ssid, const char* psk,
                           const int timeout) {
    /* Prepare the semaphore used to wait for the connection result */
    k_sem_init(&wifi_connected_sem, 0, 1);
    wifi_connect_status = -1;

    /* Register for the Wi-Fi management events */
    net_mgmt_init_event_callback(&wifi_mgmt_cb, (void*)wifi_mgmt_event_handler,
                                 WIFI_MGMT_EVENTS);
    net_mgmt_add_event_callback(&wifi_mgmt_cb);

    /* Build the connection request parameters */
    struct wifi_connect_req_params params = {0};

    params.ssid = (const uint8_t*)ssid;
    params.ssid_length = strlen(ssid);
    params.channel = WIFI_CHANNEL_ANY;
    params.band = WIFI_FREQ_BAND_UNKNOWN;
    params.mfp = WIFI_MFP_OPTIONAL;

    if (psk != NULL && strlen(psk) > 0) {
        params.psk = (const uint8_t*)psk;
        params.psk_length = strlen(psk);
        params.security = WIFI_SECURITY_TYPE_PSK;
    } else {
        params.security = WIFI_SECURITY_TYPE_NONE;
    }

    LOG_INF("Connecting to SSID \"%s\"...", ssid);

    int ret = net_mgmt(NET_REQUEST_WIFI_CONNECT, iface, &params, sizeof(params));
    if (ret) {
        LOG_ERR("Wi-Fi connect request failed (%d)", ret);
        net_mgmt_del_event_callback(&wifi_mgmt_cb);
        return ret;
    }

    /* Wait for the connect result event, up to the requested timeout */
    ret = k_sem_take(&wifi_connected_sem, K_MSEC(timeout));

    net_mgmt_del_event_callback(&wifi_mgmt_cb);

    if (ret != 0) {
        LOG_ERR("Timed out waiting for Wi-Fi connection");
        return -ETIMEDOUT;
    }

    return wifi_connect_status;
}

#endif /* CONFIG_WIFI */

int wifi_connect(const char* ssid, const char* psk, const int timeout) {
    if (ssid == NULL) {
        LOG_ERR("SSID must not be NULL");
        return -EINVAL;
    }

#if defined(CONFIG_WIFI)
    /* Prefer a real Wi-Fi interface when the platform has one. */
    struct net_if* iface = net_if_get_first_wifi();
    if (iface != NULL) {
        return wifi_do_connect(iface, ssid, psk, timeout);
    }

    LOG_WRN("No Wi-Fi interface; falling back to default network interface");
#else
    ARG_UNUSED(psk);
    ARG_UNUSED(timeout);
    LOG_INF("Wi-Fi not enabled; using default network interface");
#endif

    /*
     * No Wi-Fi available (e.g. native_sim). Fall back to whatever network
     * interface the platform provides (typically emulated Ethernet). It is
     * brought up by the net config subsystem, so there is no association
     * step to perform here.
     */
    struct net_if* iface = net_if_get_default();
    if (iface == NULL) {
        LOG_ERR("No network interface available");
        return -ENODEV;
    }

    if (!net_if_is_up(iface)) {
        LOG_WRN("Default network interface is not up");
    }

    LOG_INF("Using default network interface (no Wi-Fi association)");
    return 0;
}
```

## src/wifi.h
```c
/*
 * Standard Wi-Fi boilerplate for ESP32
 */

#pragma once

#include <zephyr/kernel.h>
#include <zephyr/net/net_if.h>
#include <zephyr/net/wifi_mgmt.h>

int wifi_connect(const char* ssid, const char* psk, const int timeout);
```
